## meta-mgaik/conf/layer.conf
```bitbake
# We have a conf and classes directory, add to BBPATH
BBPATH .= ":${LAYERDIR}"

# We have recipes-* directories, add to BBFILES
BBFILES += "${LAYERDIR}/recipes-*/*/*.bb \
            ${LAYERDIR}/recipes-*/*/*.bbappend"

BBFILE_COLLECTIONS += "meta-mgaik"
BBFILE_PATTERN_meta-mgaik = "^${LAYERDIR}/"
BBFILE_PRIORITY_meta-mgaik = "10"

LAYERDEPENDS_meta-mgaik = "core"
LAYERSERIES_COMPAT_meta-mgaik = "dunfell"
```
